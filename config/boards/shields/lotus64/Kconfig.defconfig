## config/boards/shields/lotus64/Kconfig.defconfig
```kconfig
if SHIELD_LOTUS64_LEFT
	config ZMK_KEYBOARD_NAME
		default "Lotus64"
endif

if SHIELD_LOTUS64_RIGHT
	config ZMK_KEYBOARD_NAME
		default "Lotus64"

	config ZMK_SPLIT_BLE_ROLE_CENTRAL
		default y
endif

if SHIELD_LOTUS64_LEFT || SHIELD_LOTUS64_RIGHT
	config ZMK_SPLIT
		default y
endif
```

## config/boards/shields/lotus64/Kconfig.shield
```kconfig
config SHIELD_LOTUS64_LEFT
    def_bool $(shields_list_contains,lotus64_left)

config SHIELD_LOTUS64_RIGHT
    def_bool $(shields_list_contains,lotus64_right)
```
